## firmware/t5-camera/src-patch/examples/peripherals/camera/output_web/Kconfig
```kconfig
menu "Application config"

    config WH_WIFI_SSID
        string "Roadshow WiFi SSID"
        default ""

    config WH_WIFI_PASSWORD
        string "Roadshow WiFi password"
        default ""

    config WH_CAMERA_OV2640
        bool "Use OV2640 on SPARKLEIOT_T5AI_DEV"
        default y if BOARD_CHOICE_SPARKLEIOT_T5AI_DEV

    config EXAMPLE_CAMERA_WIDTH
        int "camera width"
        default 640

    config EXAMPLE_CAMERA_HEIGHT
        int "camera height"
        default 480

    config EXAMPLE_CAMERA_FPS
        int "camera fps"
        default 15
endmenu
```
